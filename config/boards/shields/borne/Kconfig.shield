## config/boards/shields/borne/Kconfig.shield
```kconfig
# Copyright (c) 2020 The ZMK Contributors
# # SPDX-License-Identifier: MIT
#
config SHIELD_BORNE_LEFT
    def_bool $(shields_list_contains,borne_left)

config SHIELD_BORNE_RIGHT
    def_bool $(shields_list_contains,borne_right)
```
